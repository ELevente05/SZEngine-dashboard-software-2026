/*
 * ESP32-S3-N16R8 Receiver Dashboard
 */

#include <Arduino.h>
#include <U8g2lib.h>
#include <math.h>
#include "driver/twai.h"
#include <Adafruit_NeoPixel.h>

// --- PIN CONFIG ---
#define SPI_SCK   12
#define SPI_MOSI  11
#define SPI_CS    10
#define SPI_DC    9
#define SPI_RESET 8
#define BACKLIGHT_PIN 4
#define CAN_TX_PIN 47
#define CAN_RX_PIN 48
#define LED_PIN 7
#define NUM_LEDS 9

U8G2_UC1611_EA_DOGXL240_F_4W_SW_SPI u8g2(U8G2_R2, SPI_SCK, SPI_MOSI, SPI_CS, SPI_DC, SPI_RESET);
Adafruit_NeoPixel strip(NUM_LEDS, LED_PIN, NEO_GRB + NEO_KHZ800);

// --- BOOT LOGOS ---
static const unsigned char PROGMEM SZEngine_logo[984] = {
  0x00,0x80,0xFF,0xFF,0xFF,0xFF,0xFF,0xFF,0xFF,0xFF,0x01,0x00,
  0x00,0xE0,0xFC,0xFF,0xFF,0xFF,0xFF,0xFF,0xFF,0xFF,0x03,0x00,
  0x00,0xF0,0xEF,0xFF,0xFF,0xFF,0xFF,0xFF,0xFF,0xFF,0x03,0x00,
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  0x00,0x00,0x00,0x00,0xFE,0xFF,0xFF,0x1F,0x00,0x00,0x00,0x00
};

static const unsigned char PROGMEM SZEngine_title[756] = {
  0x00,0x00,0x00,0x00,0x00,0x00,0x00,0x00,0x00,0x00,0x00,0x00,0x00,0x00,0x00,0x00,0x00,0x00,0x00,0x00,0xE0,0x0F,0x00,0x00,0x00,0x00,0x00,0x00,
  0x00,0x00,0x00,0x00,0x00,0x00,0x00,0x00,0x00,0x00,0x00,0x00,0x00,0x00,0x00,0x00,0x00,0x00,0x00,0x00,0x00,0x00,0x00,0x00,0x00,0x00,0x00,0x00,
  0x00,0x00,0x00,0x00,0x00,0x00,0x00,0x00,0x00,0x00,0x00,0x00,0x00,0x00,0x00,0x00,0x00,0x00,0x00,0x00,0x00,0x00,0x00,0x00,0x00,0x00,0x00,0x00,
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  0xFF,0xFF,0xFF,0xF3,0xFF,0xFF,0xFF,0xFF,0xFF,0xFF,0xFF,0x0F,0x00,0x80,0x7F,0xFC,0xFF,0xFF,0xE7,0x1F,0x00,0x00,0xFE,0xF1,0xFF,0xFF,0x00,0x00
};

// --- VARIABLES ---
volatile int activeScreen = 1; 

// Screen 1 & 2
volatile float oilTemp = 97.0;
volatile float oilPress = 2.4;
volatile float engineWaterTemp = 89.8;
volatile float icWaterTemp = 69.0;
volatile float lambdaVal = 0.98;
volatile float intakeTemp = 43.8;
volatile float egt = 490.0;
volatile float batteryVolts = 13.3;
volatile float boostPressure = 0.3;
volatile float hybridTemp = 26.34;
volatile float hybridVolts = 39.6;
volatile int currentGear = 0;
volatile int stateOfCharge = 400;
volatile int rpm = 4000;
// Screen 3
volatile float T_1 = 26.02, T_2 = 25.94, T_3 = 25.86, T_4 = 25.88;
volatile float T_5 = 25.82, T_6 = 26.17, T_7 = 25.94, T_8 = 26.34;
volatile float T_9 = 25.73, T_10 = 26.09, T_11 = 25.61, T_12 = 26.42;
volatile float T_13 = 25.50, T_14 = 26.25, T_15 = 25.75, T_16 = 26.50;

// Screen 4
volatile float V_1 = 4.13, V_2 = 4.14, V_3 = 4.15, V_4 = 4.16;
volatile float V_5 = 4.17, V_6 = 4.18, V_7 = 4.19, V_8 = 4.13;
volatile float V_9 = 4.20, V_10 = 4.20, V_out = 41.85, I_out = 0.0;


// --- SETTINGS & TIMERS ---
int rpmStart = 4000; 
int rpmMax = 7000;   
unsigned long lastScreenUpdate = 0; 

// --- TASK HANDLE ---
TaskHandle_t TaskCAN;

// --- HELPERS ---
int16_t parseBE(uint8_t* data, int offset) { return (data[offset] << 8) | data[offset + 1]; }

// =========================================================================
// --- CORE 0: DEDICATED CAN BUS TASK ---
// =========================================================================
void TaskCANcode(void * pvParameters) {
  Serial.print("CAN Task Successfully Booted on Core: ");
  Serial.println(xPortGetCoreID());

  for(;;) { // Infinite FreeRTOS Loop
    twai_message_t rx_msg;
    
    while (twai_receive(&rx_msg, pdMS_TO_TICKS(1)) == ESP_OK) {
      switch (rx_msg.identifier) {
        case 0x520: 
          rpm = parseBE(rx_msg.data, 0); 
          lambdaVal = parseBE(rx_msg.data, 6) * 0.001; 
          break;
        case 0x530: 
          batteryVolts = parseBE(rx_msg.data, 0) * 0.01; 
          intakeTemp = parseBE(rx_msg.data, 4) * 0.1; 
          engineWaterTemp = parseBE(rx_msg.data, 6) * 0.1; 
          break;
        case 0x531: 
          egt = parseBE(rx_msg.data, 6) * 1.0; 
          break;
        case 0x536: 
          currentGear = rx_msg.data[0]; 
          oilPress = parseBE(rx_msg.data, 4) * 0.001; 
          oilTemp = parseBE(rx_msg.data, 6) * 0.1; 
          break;
        case 0x101: 
          memcpy((void*)&icWaterTemp, &rx_msg.data[4], 4); 
          break;
        case 0x104: 
          memcpy((void*)&boostPressure, &rx_msg.data[0], 4); 
          memcpy((void*)&hybridTemp, &rx_msg.data[4], 4); 
          break;
        case 0x105: 
          memcpy((void*)&hybridVolts, &rx_msg.data[0], 4); 
          stateOfCharge = rx_msg.data[5]; 
          activeScreen = rx_msg.data[6]; 
          break;

        case 0x600:
          T_1 = parseBE(rx_msg.data, 0) * 0.1;
          T_2 = parseBE(rx_msg.data, 2) * 0.1;
          T_3 = parseBE(rx_msg.data, 4) * 0.1;
          T_4 = parseBE(rx_msg.data, 6) * 0.1;
          break;
        case 0x601:
          T_5 = parseBE(rx_msg.data, 0) * 0.1;
          T_6 = parseBE(rx_msg.data, 2) * 0.1;
          T_7 = parseBE(rx_msg.data, 4) * 0.1;
          T_8 = parseBE(rx_msg.data, 6) * 0.1;
          break;
        case 0x602:
          T_9 = parseBE(rx_msg.data, 0) * 0.1;
          T_10 = parseBE(rx_msg.data, 2) * 0.1;
          T_11 = parseBE(rx_msg.data, 4) * 0.1;
          T_12 = parseBE(rx_msg.data, 6) * 0.1;
          break;
        case 0x603:
          T_13 = parseBE(rx_msg.data, 0) * 0.1;
          T_14 = parseBE(rx_msg.data, 2) * 0.1;
          T_15 = parseBE(rx_msg.data, 4) * 0.1;
          T_16 = parseBE(rx_msg.data, 6) * 0.1;
          break;
        case 0x610:
          V_1 = parseBE(rx_msg.data, 0) * 0.1;
          V_2 = parseBE(rx_msg.data, 2) * 0.1;
          V_3 = parseBE(rx_msg.data, 4) * 0.1;
          V_4 = parseBE(rx_msg.data, 6) * 0.1;
          break;
        case 0x611:
          V_5 = parseBE(rx_msg.data, 0) * 0.1;
          V_6 = parseBE(rx_msg.data, 2) * 0.1;
          V_7 = parseBE(rx_msg.data, 4) * 0.1;
          V_8 = parseBE(rx_msg.data, 6) * 0.1;
          break;
        case 0x612:
          V_9 = parseBE(rx_msg.data, 0) * 0.1;
          V_10 = parseBE(rx_msg.data, 2) * 0.1;
          V_out = parseBE(rx_msg.data, 4) * 0.1;
          I_out = parseBE(rx_msg.data, 6) * 0.1;
          break;
      }
    }
  }
}

// =========================================================================
// --- CORE 1: GRAPHICS & MAIN LOOP ---
// =========================================================================

void updateLEDs() {
  int numLedsToLight = 0;
  bool redline = false;

  if (rpm >= rpmMax) {
    redline = true;
  } else if (rpm >= rpmStart) {
    numLedsToLight = (int)((rpm - rpmStart) * NUM_LEDS / (float)(rpmMax - rpmStart)) + 1;
    if (numLedsToLight > NUM_LEDS) numLedsToLight = NUM_LEDS;
  }

  strip.clear(); 

  if (redline) {
    if ((millis() / 50) % 2 == 0) {
      for(int i = 0; i < NUM_LEDS; i++) {
        strip.setPixelColor(i, strip.Color(0, 0, 255));
      }
    }
  } else {
    for (int i = 0; i < NUM_LEDS; i++) {
      if (i >= NUM_LEDS - numLedsToLight) {
        if (i >= 6) strip.setPixelColor(i, strip.Color(0, 255, 0));       
        else if (i >= 3) strip.setPixelColor(i, strip.Color(255, 255, 0)); 
        else strip.setPixelColor(i, strip.Color(255, 0, 0));               
      }
    }
  }
  strip.show(); 
}

void drawGauge(int cx, int cy, int radius, int thickness, float minVal, float maxVal, float val) {
  if (val < minVal) val = minVal; 
  if (val > maxVal) val = maxVal;
  u8g2.drawCircle(cx, cy, radius); 
  u8g2.drawCircle(cx, cy, radius - thickness);
  float start_angle = 2.356; 
  float end_angle = 7.068;   
  float target_angle = start_angle + ((val - minVal) / (maxVal - minVal)) * (end_angle - start_angle);
  for (float a = start_angle; a <= target_angle; a += 0.05) {
    int x = cx + (radius - thickness/2) * cos(a);
    int y = cy + (radius - thickness/2) * sin(a);
    u8g2.drawDisc(x, y, thickness/2);
  }
}

// --- SCREEN 1 ---
void drawScreen1() {
  char textBuffer[32]; 
  u8g2.setFont(u8g2_font_logisoso92_tn); 
  snprintf(textBuffer, sizeof(textBuffer), "%d", currentGear);
  u8g2.drawStr(95, 125, textBuffer);
  
  u8g2.setFontMode(1);
  u8g2.setBitmapMode(1);
  u8g2.setFont(u8g2_font_profont22_tr);
  u8g2.drawStr(20, 24, "Boost");
  u8g2.drawStr(105, 24, "Gear");
  u8g2.drawStr(190, 24, "SoC");
  u8g2.drawStr(161, 104, "Hy.T"); 

  u8g2.setFont(u8g2_font_profont29_tr);
  snprintf(textBuffer, sizeof(textBuffer), "%d%%", stateOfCharge); 
  u8g2.drawStr(176, 48, textBuffer);

  u8g2.setFont(u8g2_font_profont22_tr);
  snprintf(textBuffer, sizeof(textBuffer), "%.1f", boostPressure);
  u8g2.drawStr(33, 77, textBuffer);

  u8g2.setFont(u8g2_font_profont22_tf);
  snprintf(textBuffer, sizeof(textBuffer), "%.1f°C", hybridTemp);
  u8g2.drawUTF8(161, 126, textBuffer); 

  drawGauge(50, 70, 40, 10, 0.0, 2.5, boostPressure);
}

// --- SCREEN 2 ---
void drawScreen2() {
  char textBuffer[16];
  u8g2.setFontMode(1);
  u8g2.setBitmapMode(1);

  u8g2.drawLine(0, 42, 239, 42);
  u8g2.drawLine(0, 84, 239, 84);
  u8g2.drawLine(59, 0, 59, 127);
  u8g2.drawLine(119, 0, 119, 127);
  u8g2.drawLine(180, 0, 180, 127);

  u8g2.setFont(u8g2_font_t0_16b_tr);
  u8g2.drawStr(8, 15, "Oil T");
  u8g2.drawStr(68, 15, "Oil P");
  u8g2.drawStr(122, 15, "EWaterT");
  u8g2.drawStr(183, 15, "IWaterT");

  u8g2.setFont(u8g2_font_profont22_tr);
  snprintf(textBuffer, sizeof(textBuffer), "%.1f", oilTemp); u8g2.drawStr(5, 35, textBuffer);
  snprintf(textBuffer, sizeof(textBuffer), "%.1f", oilPress); u8g2.drawStr(65, 35, textBuffer);
  snprintf(textBuffer, sizeof(textBuffer), "%.1f", engineWaterTemp); u8g2.drawStr(125, 35, textBuffer);
  snprintf(textBuffer, sizeof(textBuffer), "%.1f", icWaterTemp); u8g2.drawStr(187, 35, textBuffer);

  u8g2.setFont(u8g2_font_t0_16b_tr);
  u8g2.drawStr(4, 58, "Lambda");
  u8g2.drawStr(61, 58, "IntakeT");
  u8g2.drawStr(135, 58, "EGT");
  u8g2.drawStr(183, 58, "Battery");

  u8g2.setFont(u8g2_font_profont22_tr);
  snprintf(textBuffer, sizeof(textBuffer), "%.2f", lambdaVal); u8g2.drawStr(4, 77, textBuffer);
  snprintf(textBuffer, sizeof(textBuffer), "%.1f", intakeTemp); u8g2.drawStr(62, 77, textBuffer);
  snprintf(textBuffer, sizeof(textBuffer), "%.1f", egt); u8g2.drawStr(121, 77, textBuffer);
  snprintf(textBuffer, sizeof(textBuffer), "%.2f", batteryVolts); u8g2.drawStr(182, 77, textBuffer);

  u8g2.setFont(u8g2_font_t0_16b_tr);
  u8g2.drawStr(4, 100, "Boost");
  u8g2.drawStr(62, 100, "HybridT");
  u8g2.drawStr(123, 100, "HybridV");
  u8g2.drawStr(195, 100, "Gear");

  u8g2.setFont(u8g2_font_profont22_tr);
  snprintf(textBuffer, sizeof(textBuffer), "%.1f", boostPressure); u8g2.drawStr(4, 120, textBuffer);
  snprintf(textBuffer, sizeof(textBuffer), "%.2f", hybridTemp); u8g2.drawStr(62, 120, textBuffer);
  snprintf(textBuffer, sizeof(textBuffer), "%.2f", hybridVolts); u8g2.drawStr(121, 120, textBuffer);
  snprintf(textBuffer, sizeof(textBuffer), "%d", currentGear); u8g2.drawStr(205, 120, textBuffer);
}

// --- SCREEN 3 ---
void drawScreen3() {
  char textBuffer[16];
  u8g2.setFontMode(1);
  u8g2.setBitmapMode(1);
  
  u8g2.drawLine(0, 31, 239, 31);
  u8g2.drawLine(0, 63, 239, 63);
  u8g2.drawLine(0, 95, 239, 95);
  u8g2.drawLine(59, 0, 59, 127);
  u8g2.drawLine(119, 0, 119, 127);
  u8g2.drawLine(180, 0, 180, 127);

  u8g2.setFont(u8g2_font_t0_16b_tr);
  u8g2.drawStr(15, 12, "T_1");
  u8g2.drawStr(77, 12, "T_2");
  u8g2.drawStr(134, 12, "T_3");
  u8g2.drawStr(199, 12, "T_4");

  u8g2.setFont(u8g2_font_profont22_tr);
  snprintf(textBuffer, sizeof(textBuffer), "%.2f", T_1); u8g2.drawStr(0, 30, textBuffer);
  snprintf(textBuffer, sizeof(textBuffer), "%.2f", T_2); u8g2.drawStr(60, 30, textBuffer);
  snprintf(textBuffer, sizeof(textBuffer), "%.2f", T_3); u8g2.drawStr(121, 30, textBuffer);
  snprintf(textBuffer, sizeof(textBuffer), "%.2f", T_4); u8g2.drawStr(182, 30, textBuffer);

  u8g2.setFont(u8g2_font_t0_16b_tr);
  u8g2.drawStr(15, 43, "T_5");
  u8g2.drawStr(77, 43, "T_6");
  u8g2.drawStr(135, 43, "T_7");
  u8g2.drawStr(199, 43, "T_8");

  u8g2.setFont(u8g2_font_profont22_tr);
  snprintf(textBuffer, sizeof(textBuffer), "%.2f", T_5); u8g2.drawStr(0, 61, textBuffer);
  snprintf(textBuffer, sizeof(textBuffer), "%.2f", T_6); u8g2.drawStr(61, 61, textBuffer);
  snprintf(textBuffer, sizeof(textBuffer), "%.2f", T_7); u8g2.drawStr(121, 61, textBuffer);
  snprintf(textBuffer, sizeof(textBuffer), "%.2f", T_8); u8g2.drawStr(182, 61, textBuffer);

  // Row 3
  u8g2.setFont(u8g2_font_t0_16b_tr);
  u8g2.drawStr(15, 75, "T_9");
  u8g2.drawStr(73, 75, "T_10");
  u8g2.drawStr(130, 75, "T_11");
  u8g2.drawStr(192, 75, "T_12");

  u8g2.setFont(u8g2_font_profont22_tr);
  snprintf(textBuffer, sizeof(textBuffer), "%.2f", T_9); u8g2.drawStr(0, 93, textBuffer);
  snprintf(textBuffer, sizeof(textBuffer), "%.2f", T_10); u8g2.drawStr(60, 93, textBuffer);
  snprintf(textBuffer, sizeof(textBuffer), "%.2f", T_11); u8g2.drawStr(121, 93, textBuffer);
  snprintf(textBuffer, sizeof(textBuffer), "%.2f", T_12); u8g2.drawStr(182, 93, textBuffer);

    // Row 4
  u8g2.setFont(u8g2_font_t0_16b_tr);
  u8g2.drawStr(15, 107, "T_13");
  u8g2.drawStr(73, 107, "T_14");
  u8g2.drawStr(130, 107, "T_15");
  u8g2.drawStr(192, 107, "T_16");

  u8g2.setFont(u8g2_font_profont22_tr);
  snprintf(textBuffer, sizeof(textBuffer), "%.2f", T_13); u8g2.drawStr(0, 125, textBuffer);
  snprintf(textBuffer, sizeof(textBuffer), "%.2f", T_14); u8g2.drawStr(60, 125, textBuffer);
  snprintf(textBuffer, sizeof(textBuffer), "%.2f", T_15); u8g2.drawStr(121, 125, textBuffer);
  snprintf(textBuffer, sizeof(textBuffer), "%.2f", T_16); u8g2.drawStr(182, 125, textBuffer);
}

// --- SCREEN 4 ---
void drawScreen4() {
  char textBuffer[16];
  u8g2.setFontMode(1);
  u8g2.setBitmapMode(1);
  
  u8g2.drawLine(0, 42, 239, 42);
  u8g2.drawLine(0, 84, 239, 84);
  u8g2.drawLine(59, 0, 59, 127);
  u8g2.drawLine(119, 0, 119, 127);
  u8g2.drawLine(180, 0, 180, 127);

  u8g2.setFont(u8g2_font_t0_16b_tr);
  u8g2.drawStr(15, 15, "V_1");
  u8g2.drawStr(77, 15, "V_2");
  u8g2.drawStr(138, 15, "V_3");
  u8g2.drawStr(199, 15, "V_4");

  u8g2.setFont(u8g2_font_profont22_tr);
  snprintf(textBuffer, sizeof(textBuffer), "%.2f", V_1); u8g2.drawStr(0, 35, textBuffer);
  snprintf(textBuffer, sizeof(textBuffer), "%.2f", V_2); u8g2.drawStr(61, 35, textBuffer);
  snprintf(textBuffer, sizeof(textBuffer), "%.2f", V_3); u8g2.drawStr(121, 35, textBuffer);
  snprintf(textBuffer, sizeof(textBuffer), "%.2f", V_4); u8g2.drawStr(182, 35, textBuffer);

  u8g2.setFont(u8g2_font_t0_16b_tr);
  u8g2.drawStr(15, 58, "V_5");
  u8g2.drawStr(77, 58, "V_6");
  u8g2.drawStr(138, 58, "V_7");
  u8g2.drawStr(199, 58, "V_8");

  u8g2.setFont(u8g2_font_profont22_tr);
  snprintf(textBuffer, sizeof(textBuffer), "%.2f", V_5); u8g2.drawStr(0, 77, textBuffer);
  snprintf(textBuffer, sizeof(textBuffer), "%.2f", V_6); u8g2.drawStr(61, 77, textBuffer);
  snprintf(textBuffer, sizeof(textBuffer), "%.2f", V_7); u8g2.drawStr(121, 77, textBuffer);
  snprintf(textBuffer, sizeof(textBuffer), "%.2f", V_8); u8g2.drawStr(182, 77, textBuffer);

  u8g2.setFont(u8g2_font_t0_16b_tr);
  u8g2.drawStr(15, 100, "V_9");
  u8g2.drawStr(74, 100, "V_10");
  u8g2.drawStr(131, 100, "V_out");
  u8g2.drawStr(192, 100, "I_out");

  u8g2.setFont(u8g2_font_profont22_tr);
  snprintf(textBuffer, sizeof(textBuffer), "%.2f", V_9); u8g2.drawStr(0, 121, textBuffer);
  snprintf(textBuffer, sizeof(textBuffer), "%.2f", V_10); u8g2.drawStr(61, 121, textBuffer);
  snprintf(textBuffer, sizeof(textBuffer), "%.2f", V_out); u8g2.drawStr(121, 121, textBuffer);
  snprintf(textBuffer, sizeof(textBuffer), "%.1f", I_out); u8g2.drawStr(182, 121, textBuffer); 
}


void setup() {
  Serial.begin(115200); 
  delay(500); 
  
  pinMode(BACKLIGHT_PIN, OUTPUT); 
  digitalWrite(BACKLIGHT_PIN, HIGH); 
  
  strip.begin(); 
  strip.setBrightness(50);
  strip.clear(); 
  strip.show();
  
  u8g2.begin(); 
  u8g2.setContrast(150); 
  
  u8g2.clearBuffer();
  u8g2.setFontMode(1);
  u8g2.setBitmapMode(1);
  u8g2.drawXBM(73, 10, 94, 82, SZEngine_logo);
  u8g2.drawXBM(10, 100, 221, 27, SZEngine_title);
  u8g2.sendBuffer();
  strip.fill(strip.Color(255, 0, 0), 0, NUM_LEDS);
  strip.show();
  delay(3000);
  strip.clear();
  strip.show();
  
  twai_general_config_t g_config = TWAI_GENERAL_CONFIG_DEFAULT((gpio_num_t)CAN_TX_PIN, (gpio_num_t)CAN_RX_PIN, TWAI_MODE_NORMAL);
  g_config.rx_queue_len = 20; 
  twai_timing_config_t t_config = TWAI_TIMING_CONFIG_500KBITS(); 
  twai_filter_config_t f_config = TWAI_FILTER_CONFIG_ACCEPT_ALL();
  
  if (twai_driver_install(&g_config, &t_config, &f_config) == ESP_OK) {
    twai_start();
    Serial.println("CAN Started Successfully!");
  }

  // --- Start CORE 0 ---
  xTaskCreatePinnedToCore(
    TaskCANcode,   /* Task function */
    "TaskCAN",     /* Name of task */
    4096,          /* Stack size of task */
    NULL,          /* Parameter of the task */
    10,            /* Priority of the task */
    &TaskCAN,      /* Task handle */
    0);            /* Pin task to core 0 */
}

void loop() {
    if (Serial.available()) {
    String input = Serial.readStringUntil('\n');
    input.trim(); 
    
    if (input.startsWith("C")) {
      int desiredScreen = input.substring(1).toInt();
      if (desiredScreen == 1 || desiredScreen == 2) {
        activeScreen = desiredScreen;
        Serial.print("Switched to screen: "); 
        Serial.println(activeScreen);
      }
    }
    
    else if (input.startsWith("OT")) oilTemp = input.substring(2).toFloat();
    else if (input.startsWith("OP")) oilPress = input.substring(2).toFloat();
    else if (input.startsWith("EWT")) engineWaterTemp = input.substring(3).toFloat();
    else if (input.startsWith("IWT")) icWaterTemp = input.substring(3).toFloat();
    else if (input.startsWith("L")) lambdaVal = input.substring(1).toFloat();
    else if (input.startsWith("IT")) intakeTemp = input.substring(2).toFloat();
    else if (input.startsWith("EGT")) egt = input.substring(3).toFloat();
    else if (input.startsWith("BV")) batteryVolts = input.substring(2).toFloat();
    else if (input.startsWith("BP")) boostPressure = input.substring(2).toFloat();
    else if (input.startsWith("HT")) hybridTemp = input.substring(2).toFloat();
    else if (input.startsWith("HV")) hybridVolts = input.substring(2).toFloat();
    else if (input.startsWith("G")) currentGear = input.substring(1).toInt();
    else if (input.startsWith("SoC")) stateOfCharge = input.substring(3).toInt();
  }
  // --- CORE 1: Screen render ---
  if (millis() - lastScreenUpdate >= 33) {
    lastScreenUpdate = millis();

    updateLEDs();
    u8g2.clearBuffer();          
    
    if (activeScreen == 1) {
      drawScreen1(); 
    } else if (activeScreen == 2) {
      drawScreen2();
    } else if (activeScreen == 3) {
      drawScreen3();
    } else if (activeScreen == 4) {
      drawScreen4();
    }
    
    u8g2.sendBuffer();          
  }
}